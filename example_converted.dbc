VERSION ""

NS_ :

BS_:

BU_:

BO_ 100 ExampleMessage1: 8 Vector__XXX
 SG_ RPM : 8|16@1+ (1,0) [0|8000.0] "" Vector__XXX
 SG_ Speed : 0|8@1+ (0.1,0.0) [0|250.0] "" Vector__XXX

BO_ 200 ExampleMessage2: 4 Vector__XXX
 SG_ Voltage : 8|16@1+ (0.01,0.0) [0|65.535] "" Vector__XXX
 SG_ Temperature : 0|8@1+ (1,0) [0|215.0] "" Vector__XXX
